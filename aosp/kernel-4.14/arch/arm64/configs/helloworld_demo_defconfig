## aosp/kernel-4.14/drivers/misc/Kconfig
```kconfig
#
# Misc strange devices
#

menu "Misc devices"

source "drivers/misc/helloworld/Kconfig"

endmenu
```

## aosp/kernel-4.14/drivers/misc/helloworld/Kconfig
```kconfig
config HELLOWORLD
	tristate "Helloworld driver"
	default m
	help
	  This is the first android driver.
```
